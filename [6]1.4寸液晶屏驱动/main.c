#include "reg51.H"  
#include "intrins.h"

#define uchar unsigned char
#define uint unsigned int

 uchar code LCD_DATA[1717] = {    //全屏图片：让老王赶紧上新
0X00,0X00,0X00,0X00,0X00,0X00,0X00,0X00,0X00,0X00,0X00,0X00,0X00,0X00,0X00,0X00,
0X00,0X00,0X00,0X00,0X00,0X00,0X00,0X00,0X00,0X00,0X00,0X00,0X0C,0XFC,0X00,0X00,
0X00,0X00,0XC0,0X0F,0X00,0X00,0X00,0X00,0X00,0X00,0X00,0X00,0XC0,0X0F,0XFC,0X00,
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0X00,0X00,0X00,0X00,0X00,
};
 char code LCD_DATA2[1700]=
 {0X00,0X00,0X00,0X00,0X00,0X00,0XBC,0X00,0X00,0X00,0X00,0X00,0X00,0X00,0X00,0X00,
0X00,0X00,0X00,0X00,0X00,0X00,0X00,0XDF,0X00,0X00,0X00,0X00,0X00,0X00,0X00,0X00,
0X00,0X00,0X00,0X00,0X00,0X00,0X00,0XC0,0X03,0X03,0X00,0X00,0X00,0X00,0X00,0X00,
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0X00,0X00,0X00,0X00,0X00,0X00,0X00,0X00,0XFF,0X07,0X00,
};
uchar code LCD_INT[74] =          //LCD的初始化指令，具体含义写在后面
	{
		0X78,0X80,	//选择地址,0X3C，加上W/R为0X78
		0X01,0X80,	//进0页
		0X09,0X80,	//选1页PS:选页指令在0页。
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		0X0B,0X40,	//设定VLCD为5x，X040：后面开始写DDRAM显示数据
	};
	
//delay ----------------------------------------------------------------------
void delayus()
{

}

void delayms()
{
	uchar i, j;
	i = 32;
	j = 40;
	while (j--)
	{	while (i--);
	}
	}


//I2C init ----------------------------------------------------------------------
sbit I2CRST = P2^0; //定义I2C引脚
sbit SCL =P2^1;
sbit SDA = P2^2;

void I2C_SOFT_START() //软件模拟I2C 开始信号
{
	SDA = 1;
	delayus();
	SCL = 1;
	delayus();
	SDA = 0;
	delayus();
	SCL	=	0;
	SDA	= 1;
}

void I2C_SOFT_STOP() //软件模拟I2C 停止信号
{
	SDA = 0;
	delayus();
	SCL = 1;
	delayus();
	SDA = 1;
	delayus();
	SCL	=	0;
	SDA	= 1;
}


void I2C_SOFT_SEND(uchar S_SND)   //软件模拟I2C，写1字节数据
{
	uchar i,SOFT_ACK,SND;
	SOFT_ACK = 1;
while (SOFT_ACK)	
{
	SND = S_SND;
 for (i=8;i!=0;i--)
	{
		if(SND & 0X80)
			SDA = 1;
		else SDA = 0;
		SND <<=1;
		delayus();
//		delayus();
		SCL = 1;
		delayus();
//		delayus();
		SCL=0;
		delayus();
	}
		SDA =1;
		delayus();
		SCL = 1;
		if(~SDA)
		{
			delayus();  //貌似少了这个延时，有时候不能顺利初始化
			SOFT_ACK = 0; //判断是否重发
		}SCL=0;
}
}

//LCD INT ------------------------------------------------------
void LCD_INIT()
{
	uint num;
	I2CRST = 0;						//RST腿拉低
	delayms();
	I2CRST = 1;
  delayms();
	delayms();
	delayms();
	delayms();
	I2C_SOFT_START();			//发送开始信号
		for(num=0;num<=74;num++)
		{
			I2C_SOFT_SEND(LCD_INT[num]);

		}										
	}

void LCD_TEST1()        //连续写屏
{
	uint num;
			for(num=0;num<=sizeof(LCD_DATA2);num++)
		{
			I2C_SOFT_SEND(LCD_DATA2[num]);

		}	
	}

void LCD_TEST2()        //连续写屏
{
	uint num;
			for(num=0;num<=sizeof(LCD_DATA);num++)
		{
			I2C_SOFT_SEND(LCD_DATA[num]);

		}	
	}
void Delay1000ms()		//@11.0592MHz
{
	unsigned char i, j, k;

	i = 15;
	j = 2;
	k = 235;
	do
	{
		do
		{
			while (--k);
		} while (--j);
	} while (--i);
}
	
void LCD_SET_XY(uchar x,y) //设定在X,Y位置写数据
{

I2C_SOFT_STOP();				//芯片没有返回指令列表的指令，SO，结束I2C，再打开。
	delayus();
I2C_SOFT_START();	

I2C_SOFT_SEND(0X78);	//选地址
I2C_SOFT_SEND(0X80);	//这个蛋疼的芯片，每次写一条指令都要说明下一条是指令还是数据，所以这么多0X80。
I2C_SOFT_SEND(0X01);	//选页指令
I2C_SOFT_SEND(0X80);	
I2C_SOFT_SEND(0X040|y);	//设置Y地址，（0-16）
I2C_SOFT_SEND(0X80);		
I2C_SOFT_SEND(0X80|x);	//设置X地址，	（0-100）
I2C_SOFT_SEND(0X40);		//0x40表示后面开始写数据
}


void main()
{
uchar n,m;
LCD_INIT();		//LCD初始化
	
while(1)
{
	LCD_SET_XY(0,0);	//设定从XY位置开始更新数据。
	LCD_TEST2();	//连续写数据测试下
	LCD_SET_XY(0,0);	//设定从XY位置开始更新数据。
	LCD_TEST1();	//连续写数据测试下
	Delay1000ms();
}
//	for(m=96;m>0;m--)
//	for(n=17;n>0;n--)		//我还不会用字库，先在这个位置写几个黑点测试下。
//	{
//		if(n==17)
//			I2C_SOFT_SEND(0XFF);
//		else if(n==2)
//			I2C_SOFT_SEND(0Xfc);
//		else
//			I2C_SOFT_SEND(0X00);
//	}
	
	while(1);
}